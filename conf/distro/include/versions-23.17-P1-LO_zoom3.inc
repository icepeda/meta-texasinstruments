## conf/distro/include/versions-23.17-P1-LO_zoom3.inc
```bitbake
# omap3630 zoom3 specific versions

# baseport
SRCREV_pn-x-load ?= "44091bc1ddec7fc712c492f9e6b36cf4d72e8120"
SRCREV_pn-u-boot ?= "5589e8145624d6ad06414b5704ea1e0354b063b8"
```

## conf/distro/include/versions-23.17.inc
```bitbake
### TASKS AND IMAGES ###
PREFERRED_VERSION_task-omap-bridge.bb =			"1.0"
PREFERRED_VERSION_task-omap-connectivity.bb =		"1.0"
PREFERRED_VERSION_task-omap-gfx.bb =			"1.0"
PREFERRED_VERSION_task-omap-gst.bb =			"1.0"
PREFERRED_VERSION_task-omap-omx.bb =			"1.0"
PREFERRED_VERSION_task-omap-sn.bb =			"1.0"
PREFERRED_VERSION_task-omap-test.bb =			"1.0"
PREFERRED_VERSION_omap-image-minimal-mtdutils.bb =	"1.0"
PREFERRED_VERSION_omap-image-minimal.bb =		"1.0"
PREFERRED_VERSION_omap-image-mm.bb =			"1.0"
PREFERRED_VERSION_omap-image-sato.bb =			"1.0

### BASEPORT ###
PREFERRED_VERSION_x-load =			"4.63"
PREFERRED_VERSION_u-boot =			"5.11"
PREFERRED_VERSION_linux-tiomap =	"2.6.24.7-5.25"

### BRIDGE AND FRIENDS ###
PREFERRED_VERSION_tidspbridge-module =		"23.17"
PREFERRED_VERSION_tidspbridge-lib =		"23.17"
PREFERRED_VERSION_tidspbridge-samples =		"4.54"
PREFERRED_VERSION_tidspbridge-extra =		"23.17"
PREFERRED_VERSION_tidspbridge-cgt6x =		"6.0.7"
PREFERRED_VERSION_tidspbridge-bios =		"5.33.02"
PREFERRED_VERSION_tidspbridge-dllcreate =	"23.11"

### BASEIMAGE ###
PREFERRED_VERSION_baseimage =				"1.2-P2"
PREFERRED_VERSION_baseimage-avsync =	   		"1.2-P2"
PREFERRED_VERSION_baseimage-dasf =			"1.2-P2"
PREFERRED_VERSION_baseimage-hal =			"1.2-P2"
PREFERRED_VERSION_baseimage-inst2 =			"1.2-P2"
PREFERRED_VERSION_baseimage-make-system =		"1.2-P2"
PREFERRED_VERSION_baseimage-masterconfig =		"23.x"
PREFERRED_VERSION_baseimage-samplerateconverter =	"1.2-P2"
PREFERRED_VERSION_baseimage-tmon =			"1.2-P2"
PREFERRED_VERSION_baseimage-utils =			"1.2-P2"

### SOCKET NODES AND CODECS ###
PREFERRED_VERSION_tisocketnode-control-task =		"3.40"
## DSPISP ##
PREFERRED_VERSION_tisocketnode-ipp =			"3.2"
PREFERRED_VERSION_tisocketnode-dfgm =			"3.2"
PREFERRED_VERSION_tisocketnode-algo =			"3.2"
PREFERRED_VERSION_tisocketnode-conversions =		"3.2"
PREFERRED_VERSION_tisocketnode-pplib =			"3.2"
## SYSTEM ##
PREFERRED_VERSION_tisocketnode-usn =			"3.2"
## AUDIO ##
PREFERRED_VERSION_tisocketnode-mp3 =			"3.2"
PREFERRED_VERSION_tisocketnode-mp3-codec =		"3.2"
PREFERRED_VERSION_tisocketnode-mpeg4aacdec =		"3.2"
PREFERRED_VERSION_tisocketnode-mpeg4aacdec-codec =	"3.2"
PREFERRED_VERSION_tisocketnode-mpeg4aacenc =		"3.2"
PREFERRED_VERSION_tisocketnode-mpeg4aacenc-codec =	"3.2"
PREFERRED_VERSION_tisocketnode-wma9 =			"3.2"
PREFERRED_VERSION_tisocketnode-wma9-codec =		"3.2"
PREFERRED_VERSION_tisocketnode-pcmdec =			"3.1"
PREFERRED_VERSION_tisocketnode-pcmenc =			"3.2"
PREFERRED_VERSION_tisocketnode-ul2dl =			"3.2"
PREFERRED_VERSION_tisocketnode-ima-adpcmdec =		"3.2"
PREFERRED_VERSION_tisocketnode-ima-adpcmdec-codec =	"3.2"	
PREFERRED_VERSION_tisocketnode-ima-adpcmenc =		"3.2"
PREFERRED_VERSION_tisocketnode-ima-adpcmenc-codec =	"3.2"
# SPEECH #
PREFERRED_VERSION_tisocketnode-nbamrdec =		"3.2"
PREFERRED_VERSION_tisocketnode-nbamrdec-codec =		"3.2"
PREFERRED_VERSION_tisocketnode-nbamrenc =		"3.2"
PREFERRED_VERSION_tisocketnode-nbamrenc-codec =		"3.2"
PREFERRED_VERSION_tisocketnode-wbamrdec =		"3.2"
PREFERRED_VERSION_tisocketnode-wbamrdec-codec =		"3.2"
PREFERRED_VERSION_tisocketnode-wbamrenc =		"3.2"
PREFERRED_VERSION_tisocketnode-wbamrenc-codec =		"3.2"
PREFERRED_VERSION_tisocketnode-gsmfrdec =		"3.2"
PREFERRED_VERSION_tisocketnode-gsmfrdec-codec =		"3.2"
PREFERRED_VERSION_tisocketnode-gsmfrenc =		"3.2"
PREFERRED_VERSION_tisocketnode-gsmfrenc-codec =		"3.2"
PREFERRED_VERSION_tisocketnode-gsmhrdec =		"3.2"
PREFERRED_VERSION_tisocketnode-gsmhrdec-codec =		"3.2"
PREFERRED_VERSION_tisocketnode-gsmhrenc =		"3.2"
PREFERRED_VERSION_tisocketnode-gsmhrenc-codec =		"3.2"
PREFERRED_VERSION_tisocketnode-common =			"3.2"
# VIOP #
PREFERRED_VERSION_tisocketnode-nmu-plc-vad =		"3.2"
PREFERRED_VERSION_tisocketnode-g711dec =		"3.2"
PREFERRED_VERSION_tisocketnode-g711dec-codec =		"3.2"
PREFERRED_VERSION_tisocketnode-g711enc =		"3.2"
PREFERRED_VERSION_tisocketnode-g711enc-codec =		"3.2"
PREFERRED_VERSION_tisocketnode-g722dec =		"3.2"
PREFERRED_VERSION_tisocketnode-g722dec-codec =		"3.2"
PREFERRED_VERSION_tisocketnode-g722enc =		"3.2"
PREFERRED_VERSION_tisocketnode-g722enc-codec =		"3.2"
PREFERRED_VERSION_tisocketnode-g723dec =		"3.2"
PREFERRED_VERSION_tisocketnode-g723dec-codec =		"3.2"
PREFERRED_VERSION_tisocketnode-g723enc =		"3.2"
PREFERRED_VERSION_tisocketnode-g723enc-codec =		"3.2"
PREFERRED_VERSION_tisocketnode-g726dec =		"3.2"
PREFERRED_VERSION_tisocketnode-g726dec-codec =		"3.2"
PREFERRED_VERSION_tisocketnode-g726enc =		"3.2"
PREFERRED_VERSION_tisocketnode-g726enc-codec =		"3.2"
PREFERRED_VERSION_tisocketnode-g729dec =		"3.2"
PREFERRED_VERSION_tisocketnode-g729dec-codec =		"3.2"
PREFERRED_VERSION_tisocketnode-g729enc =		"3.2"
PREFERRED_VERSION_tisocketnode-g729enc-codec =		"3.2"
PREFERRED_VERSION_tisocketnode-ilbcdec =		"3.2"
PREFERRED_VERSION_tisocketnode-ilbcdec-codec =		"3.2"
PREFERRED_VERSION_tisocketnode-ilbcenc =		"3.2"
PREFERRED_VERSION_tisocketnode-ilbcenc-codec =		"3.2"
PREFERRED_VERSION_tisocketnode-rageckodec = 		"3.2"
PREFERRED_VERSION_tisocketnode-rageckodec-codec = 	"3.2"
## VIDEO ##
PREFERRED_VERSION_tisocketnode-h264dec =		"3.2"
PREFERRED_VERSION_tisocketnode-h264dec-codec =		"3.2"
PREFERRED_VERSION_tisocketnode-h264enc =		"3.2"
PREFERRED_VERSION_tisocketnode-h264enc-codec =		"3.2"
PREFERRED_VERSION_tisocketnode-mpeg4dec =		"3.2"
PREFERRED_VERSION_tisocketnode-mpeg4dec-codec =		"3.2"
PREFERRED_VERSION_tisocketnode-mpeg4enc =		"3.2"
PREFERRED_VERSION_tisocketnode-mpeg4enc-codec =		"3.2"
PREFERRED_VERSION_tisocketnode-mpeg4-720pdec =		"3.2"
PREFERRED_VERSION_tisocketnode-mpeg4-720pdec-codec = 	"3.2"
PREFERRED_VERSION_tisocketnode-mpeg4-720penc = 		"3.2"
PREFERRED_VERSION_tisocketnode-mpeg4-720penc-codec = 	"3.2"
PREFERRED_VERSION_tisocketnode-wmv9 =			"3.2"
PREFERRED_VERSION_tisocketnode-wmv9-codec =		"3.2"
PREFERRED_VERSION_tisocketnode-mpeg2 =			"3.2"
PREFERRED_VERSION_tisocketnode-mpeg2-codec =		"3.2"
PREFERRED_VERSION_tisocketnode-spark =			"3.2"
PREFERRED_VERSION_tisocketnode-spark-codec =		"3.2"
PREFERRED_VERSION_tisocketnode-vpp =			"3.2"
PREFERRED_VERSION_tisocketnode-vgpop = 			"3.2"
PREFERRED_VERSION_tisocketnode-ringio =			"3.2"
PREFERRED_VERSION_tisocketnode-rv89combodec = 		"3.2"
PREFERRED_VERSION_tisocketnode-rv89combodec-codec =	"3.2"
## IMAGE ##
#JPEG Decoder
PREFERRED_VERSION_tisocketnode-jpegdec =		"3.2"
PREFERRED_VERSION_tisocketnode-jpegdec-codec =		"3.2"
#JPEG Encoder
PREFERRED_VERSION_tisocketnode-jpegenc =		"3.2"
PREFERRED_VERSION_tisocketnode-jpegenc-codec =		"3.2"

### OPENMAX ###
PREFERRED_PROVIDER_virtual/openmax-il =			"meta-tiopenmax"
PREFERRED_VERSION_tiopenmax-cspec =			"3.23"
# Audio
PREFERRED_VERSION_tiopenmax-aacdec = 			"3.23"
PREFERRED_VERSION_tiopenmax-aacenc = 			"3.23"
PREFERRED_VERSION_tiopenmax-armaacdec = 		"3.23"
PREFERRED_VERSION_tiopenmax-armaacenc = 		"3.23"
PREFERRED_VERSION_tiopenmax-g711dec = 			"3.23"
PREFERRED_VERSION_tiopenmax-g711enc = 			"3.23"
PREFERRED_VERSION_tiopenmax-g722dec = 			"3.23"
PREFERRED_VERSION_tiopenmax-g722enc = 			"3.23"
PREFERRED_VERSION_tiopenmax-g723dec = 			"3.23"
PREFERRED_VERSION_tiopenmax-g723enc = 			"3.23"
PREFERRED_VERSION_tiopenmax-g726dec = 			"3.23"
PREFERRED_VERSION_tiopenmax-g726enc = 			"3.23"
PREFERRED_VERSION_tiopenmax-g729dec = 			"3.23"
PREFERRED_VERSION_tiopenmax-g729enc = 			"3.23"
PREFERRED_VERSION_tiopenmax-gsmfrdec = 			"3.23"
PREFERRED_VERSION_tiopenmax-gsmfrenc = 			"3.23"
PREFERRED_VERSION_tiopenmax-gsmhrdec = 			"3.23"
PREFERRED_VERSION_tiopenmax-gsmhrenc = 			"3.23"
PREFERRED_VERSION_tiopenmax-ilbcdec = 			"3.23"
PREFERRED_VERSION_tiopenmax-ilbcenc = 			"3.23"
PREFERRED_VERSION_tiopenmax-imaadpcmdec = 		"3.23"
PREFERRED_VERSION_tiopenmax-imaadpcmenc = 		"3.23"
PREFERRED_VERSION_tiopenmax-mp3dec = 			"3.23"
PREFERRED_VERSION_tiopenmax-nbamrdec = 			"3.23"
PREFERRED_VERSION_tiopenmax-nbamrenc = 			"3.23"
PREFERRED_VERSION_tiopenmax-pcmdec = 			"3.23"
PREFERRED_VERSION_tiopenmax-pcmenc = 			"3.23"
PREFERRED_VERSION_tiopenmax-rageckodec = 		"3.23"
PREFERRED_VERSION_tiopenmax-wbamrdec = 			"3.23"
PREFERRED_VERSION_tiopenmax-wbamrenc = 			"3.23"
PREFERRED_VERSION_tiopenmax-wmadec = 			"3.23"
# Video
PREFERRED_VERSION_tiopenmax-camera = 			"3.23"
PREFERRED_VERSION_tiopenmax-postprocessor = 		"3.23"
PREFERRED_VERSION_tiopenmax-prepostprocessor = 		"3.23"
PREFERRED_VERSION_tiopenmax-rmparser = 			"3.23"
PREFERRED_VERSION_tiopenmax-rmrvparser = 		"3.23"
PREFERRED_VERSION_tiopenmax-rvdecoder = 		"3.23"
PREFERRED_VERSION_tiopenmax-videodecoder = 		"3.23"
PREFERRED_VERSION_tiopenmax-videoencoder = 		"3.23"
# Image
PREFERRED_VERSION_tiopenmax-jpegdec = 			"3.23"
PREFERRED_VERSION_tiopenmax-jpegenc = 			"3.23"
# System
PREFERRED_VERSION_tiopenmax-audiomanager = 		"3.23"
PREFERRED_VERSION_tiopenmax-clock = 			"3.23"
PREFERRED_VERSION_tiopenmax-common = 			"3.23"
PREFERRED_VERSION_tiopenmax-core = 			"3.23"
PREFERRED_VERSION_tiopenmax-khronos = 			"3.23"
PREFERRED_VERSION_tiopenmax-lcml =			"3.23"
PREFERRED_VERSION_tiopenmax-perf =			"3.23"
PREFERRED_VERSION_tiopenmax-policymanager = 		"3.23"
#PREFERRED_VERSION_tiopenmax-ram = 			"3.23"
PREFERRED_VERSION_tiopenmax-resourcemanager =		"3.23"
PREFERRED_VERSION_tiopenmax-resourcemanagerproxy =	"3.23"
# Applications
PREFERRED_VERSION_tiopenmax-avplay = 			"3.23"
PREFERRED_VERSION_tiopenmax-avrecord = 			"3.23"
PREFERRED_VERSION_tiopenmax-imagecapture = 		"3.23"
PREFERRED_VERSION_tiopenmax-imagedisplay = 		"3.23"
PREFERRED_VERSION_tiopenmax-videocapture = 		"3.23"
PREFERRED_VERSION_tiopenmax-videodisplay = 		"3.23"
# Other
PREFERRED_VERSION_mm-isp =				"1.15"

### GSTREAMER ###
PREFERRED_VERSION_libgoo =		"5.17"
PREFERRED_VERSION_gst-goo =		"5.17"
PREFERRED_VERSION_gst-pyapps =		"5.13"

### CONNECTIVITY ###
PREFERRED_VERSION_wilink = 		"23-1.3"
PREFERRED_VERSION_btfm = 		"23-1.3"

### GRAPHICS ###
PREFERRED_VERSION_sgx-kernel-module =	"1.3.2.1"
PREFFERED_VERSION_sgx-lib-noxws =	"1.3.2.1"

### OPEN SOURCE DEPENDENCIES ###
PREFERRED_VERSION_gst-plugins-bad =	"0.10.8"
PREFERRED_VERSION_gst-plugins-ugly =	"0.10.9"
PREFERRED_VERSION_gst-plugins-good =	"0.10.7"
PREFERRED_VERSION_gst-qtmux =		"svn"
PREFERRED_VERSION_check =		"0.9.5"
PREFERRED_VERSION_amrnb =		"7.0.0.2"
PREFERRED_VERSION_amrwb =		"7.0.0.1"
#PREFERRED_VERSION_openobex =		"0.22"
PREFERRED_VERSION_bison-1.875 =		"1.875"
PREFERRED_VERSION_bison-native-1.875 =	"1.875"
PREFERRED_VERSION_flex =		"2.5.35"
PREFERRED_VERSION_flex-native =		"2.5.35"
PREFERRED_VERSION_iperf =		"2.0.4"
PREFERRED_VERSION_libmms =		"0.3"

### TOOLCHAIN ###
PREFERRED_VERSION_external-csl-toolchain =	"2008q3-72"

### TEST ###
PREFERRED_VERSION_cheese	=	"2.24.3"
PREFERRED_VERSION_intltool	=	"0.40.0"

### EXTRA (will be replaced by pokyomap in subsequent releases) ###
PREFERRED_VERSION_gtk+		=	"2.14.7"
PREFERRED_VERSION_glib-2.0	=	"2.18.4"
PREFERRED_VERSION_pango		=	"1.22.4"
PREFERRED_VERSION_cairo		=	"1.8.6"
PREFERRED_VERSION_pixman	=	"0.14.0"
```
